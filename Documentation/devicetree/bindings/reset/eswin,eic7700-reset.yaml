## Documentation/devicetree/bindings/reset/eswin,eic7700-reset.yaml
```yaml
# SPDX-License-Identifier: (GPL-2.0 OR BSD-2-Clause)
%YAML 1.2
---
$id: http://devicetree.org/schemas/reset/eswin,eic7700-reset.yaml#
$schema: http://devicetree.org/meta-schemas/core.yaml#

title: ESWIN EIC7700 SoC Reset Controller

maintainers:
  - Inochi Amaoto <inochiama@outlook.com>

properties:
  compatible:
    const: eswin,eic7700-reset

  reg:
    maxItems: 1

  "#reset-cells":
    const: 1

required:
  - compatible
  - reg
  - "#reset-cells"

additionalProperties: false

examples:
  - |
    reset-controller@51828000 {
        compatible = "eswin,eic7700-reset";
        reg = <0x51828000 0x100>;
        #reset-cells = <1>;
    };
```

## Documentation/devicetree/bindings/riscv/eswin.yaml
```yaml
# SPDX-License-Identifier: (GPL-2.0 OR MIT)
%YAML 1.2
---
$id: http://devicetree.org/schemas/riscv/eswin.yaml#
$schema: http://devicetree.org/meta-schemas/core.yaml#

title: ESWIN SoC-based boards

maintainers:
  - Inochi Amaoto <inochiama@gmail.com>

description:
  ESWIN SoC-based boards

properties:
  $nodename:
    const: '/'
  compatible:
    oneOf:
      - items:
          - enum:
              - sifive,hifive-premier-p550
          - const: eswin,eic7700

additionalProperties: true

...
```

## drivers/clk/eswin/Kconfig
```kconfig
# SPDX-License-Identifier: GPL-2.0
# common clock support for ESWIN SoC family.

config CLK_ESWIN_EIC7700
	tristate "Support for the ESWIN EIC7700 series SoCs clock controller"
	depends on ARCH_ESWIN || COMPILE_TEST
	help
	  This driver supports clock controller of ESWIN EIC7700 series SoC.
	  The driver require a 24MHz Oscillator to function generate clock.
	  It includes PLLs, common clock function and some vendor clock for
	  IPs of EIC7700 series SoC
```
