## Documentation/devicetree/bindings/interrupt-controller/sophgo,sg2042-pcie-msi.yaml
```yaml
# SPDX-License-Identifier: (GPL-2.0-only OR BSD-2-Clause)
%YAML 1.2
---
$id: http://devicetree.org/schemas/interrupt-controller/sophgo,sg2042-pcie-msi.yaml#
$schema: http://devicetree.org/meta-schemas/core.yaml#

title: Sophgo SG2042 PCIe MSI interrupt controller

maintainers:
  - Inochi Amaoto <inochiama@outlook.com>

description:
  The PCIe MSI bridge on Sophgo SG2042 SoC is a device to support MSI
  interrupt over the PLIC interrupt controller. This controller supports
  dynamic IRQ allocation for the PCIe device.

properties:
  compatible:
    enum:
      - sophgo,sg2042-pcie-msi
      - sophgo,sg2044-pcie-msi

  reg:
    maxItems: 1

  msi-controller: true

  msi-ranges:
    maxItems: 1

  sophgo,msi-device-reg:
    $ref: /schemas/types.yaml#/definitions/uint64
    description:
      Physical address for the driver for reporting MSI message content.

required:
  - compatible
  - reg
  - msi-controller
  - msi-ranges

unevaluatedProperties: false

allOf:
  - $ref: /schemas/interrupt-controller/msi-controller.yaml#

examples:
  - |
    #include <dt-bindings/interrupt-controller/irq.h>

    interrupt-controller@50000000 {
      compatible = "sophgo,sg2044-pcie-msi";
      reg = <0x50000000 0x0000800>;
      msi-controller;
      msi-ranges = <&intc 352 IRQ_TYPE_LEVEL_HIGH 512>;
      sophgo,msi-device-reg = <0x0 0x7ee00000>;
    };
...
```

## Documentation/devicetree/bindings/soc/sophgo/sophgo,sg2044-top-syscon.yaml
```yaml
# SPDX-License-Identifier: (GPL-2.0 OR BSD-2-Clause)
%YAML 1.2
---
$id: http://devicetree.org/schemas/soc/sophgo/sophgo,sg2044-top-syscon.yaml#
$schema: http://devicetree.org/meta-schemas/core.yaml#

title: Sophgo SG2044 SoC system controller

maintainers:
  - Inochi Amaoto <inochiama@gmail.com>

properties:
  compatible:
    items:
      - const: sophgo,sg2044-top-syscon
      - const: syscon

  reg:
    maxItems: 1

required:
  - compatible
  - reg

additionalProperties: false

examples:
  - |
    syscon@50000000 {
        compatible = "sophgo,sg2044-top-syscon", "syscon";
        reg = <0x50000000 0x1000>;
    };

...
```

## drivers/accel/sophgo/Kconfig
```kconfig
# SPDX-License-Identifier: GPL-2.0-only
#
# Sophgo TPU accelerators driver
#

config DRM_ACCEL_SOPHGO_CV1800
	tristate "Sophgo CV18XX/SG200X TPU accelerators"
	depends on DRM_ACCEL
	depends on PCI && HAS_IOMEM
	depends on ARCH_SOPHGO
	help
	  The user-space interface is described in
	  include/uapi/drm/sophgo/cv1800_tpu_accel.h

	  If unsure, say N.

	  To compile this driver as a module, choose M here: the
	  module will be called habanalabs.
```
