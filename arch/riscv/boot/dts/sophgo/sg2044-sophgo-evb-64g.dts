// SPDX-License-Identifier: (GPL-2.0 OR MIT)
/*
 * Copyright (C) 2024 Inochi Amaoto <inochiama@outlook.com>
 */

#include "sg2044-sophgo-evb.dts"

/ {
	memory@80000000 {
		device_type = "memory";
		reg = <0x00000000 0x80000000 0x00000010 0x00000000>;
	};
};
